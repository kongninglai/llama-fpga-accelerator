## board/dotprod-fit/image-dotprod.its
```
/dts-v1/;
/ {
  timestamp = [64 15 ee 01];
  description = [55 2d 42 6f 6f 74 20 66 69 74 49 6d 61 67 65 20 66 6f 72 20 50 59 4e 51 20 61 72 6d 20 6b 65 72 6e 65 6c 00];
  #address-cells = [00 00 00 01];
  images {
    kernel-0 {
      description = [4c 69 6e 75 78 20 4b 65 72 6e 65 6c 00];
      data = /incbin/("kernel.bin");
      type = [6b 65 72 6e 65 6c 00];
      arch = [61 72 6d 36 34 00];
      os = [6c 69 6e 75 78 00];
      compression = [6e 6f 6e 65 00];
      load = [00 08 00 00];
      entry = [00 08 00 00];
      hash-1 {
        value = [ef a1 85 ef 0b 02 c7 b8 7d f5 50 74 e4 75 25 dc 78 67 58 7a];
        algo = [73 68 61 31 00];
      };
    };
    fdt-0 {
      description = [46 6c 61 74 74 65 6e 65 64 20 44 65 76 69 63 65 20 54 72 65 65 20 62 6c 6f 62 00];
      data = /incbin/("dotprod.dtb");
      type = [66 6c 61 74 5f 64 74 00];
      arch = [61 72 6d 36 34 00];
      compression = [6e 6f 6e 65 00];
      hash-1 {
        value = [db 07 ee bd a6 1a 0f 7f df 06 9b df 23 bb d2 7b 9c f5 73 cc];
        algo = [73 68 61 31 00];
      };
    };
  };
  configurations {
    default = [63 6f 6e 66 2d 31 00];
    conf-1 {
      description = [42 6f 6f 74 20 4c 69 6e 75 78 20 6b 65 72 6e 65 6c 20 77 69 74 68 20 46 44 54 20 62 6c 6f 62 00];
      kernel = [6b 65 72 6e 65 6c 2d 30 00];
      fdt = [66 64 74 2d 30 00];
      hash-1 {
        algo = [73 68 61 31 00];
      };
    };
  };
};
```
